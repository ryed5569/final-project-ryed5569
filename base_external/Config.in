## base_external/Config.in
```kconfig
menu "AESD External Packages"
source "$BR2_EXTERNAL_assignment_base_PATH/package/mcp3221/Config.in"
endmenu
```

## base_external/package/mcp3221/Config.in
```kconfig
config BR2_PACKAGE_MCP3221
    bool "mcp3221 reader"
    select BR2_PACKAGE_SQLITE
    help
      Userspace tools for MCP3221 (12-bit) over i2c-dev.
      Installs:
        - mcp3221_read: CLI reader
        - mcp3221d: daemon + JSON API + simple web UI
```
